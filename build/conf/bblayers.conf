## build/conf/bblayers.conf
```bitbake
# POKY_BBLAYERS_CONF_VERSION is increased each time build/conf/bblayers.conf
# changes incompatibly
POKY_BBLAYERS_CONF_VERSION = "2"

BBPATH := "${TOPDIR}"
BBFILES ?= ""

SOURCES_PATH := "${TOPDIR}/../sources/"

BBLAYERS ?= ""
BBLAYERS:append = " ${SOURCES_PATH}/poky/meta "
BBLAYERS:append = " ${SOURCES_PATH}/poky/meta-poky "
BBLAYERS:append = " ${SOURCES_PATH}/poky/meta-yocto-bsp "
BBLAYERS:append = " ${SOURCES_PATH}/meta-arm/meta-arm-toolchain "
BBLAYERS:append = " ${SOURCES_PATH}/meta-arm/meta-arm "
BBLAYERS:append = " ${SOURCES_PATH}/meta-arm/meta-arm-bsp "
BBLAYERS:append = " ${SOURCES_PATH}/meta-virtualization "
BBLAYERS:append = " ${SOURCES_PATH}/meta-freescale "
BBLAYERS:append = " ${SOURCES_PATH}/meta-freescale-distro "
BBLAYERS:append = " ${SOURCES_PATH}/meta-openembedded/meta-oe "
BBLAYERS:append = " ${SOURCES_PATH}/meta-openembedded/meta-python "
BBLAYERS:append = " ${SOURCES_PATH}/meta-openembedded/meta-gnome "
BBLAYERS:append = " ${SOURCES_PATH}/meta-openembedded/meta-multimedia "
BBLAYERS:append = " ${SOURCES_PATH}/meta-openembedded/meta-networking "
BBLAYERS:append = " ${SOURCES_PATH}/meta-openembedded/meta-filesystems "
BBLAYERS:append = " ${SOURCES_PATH}/meta-imx/meta-bsp "
BBLAYERS:append = " ${SOURCES_PATH}/meta-imx/meta-sdk "
BBLAYERS:append = " ${SOURCES_PATH}/meta-obe "
```

## build/conf/local.conf
```bitbake
#
# Machine Selection
#
MACHINE ?= "poc"
DISTRO ?= "obe-imx-wayland"

PACKAGE_CLASSES ?= "package_deb"
SDKMACHINE ?= "aarch64"
EXTRA_IMAGE_FEATURES ?= "debug-tweaks"
ACCEPT_FSL_EULA = "1"

PREFERRED_VERSION_linux-fslc = "6.6%"
PREFERRED_PROVIDER_virtual/kernel = "linux-fslc"

IMAGE_INSTALL:append = " i2c-tools"
IMAGE_INSTALL:append = " kernel-modules"
IMAGE_INSTALL:append = " v4l-utils"
IMAGE_INSTALL:append = " libcamera"
IMAGE_INSTALL:append = " poc-utils"

# the init manager can be mdev-busybox, sysvinit or systemd
INIT_MANAGER = "systemd"

PATCHRESOLVE = "noop"
BB_DISKMON_DIRS ??= "\
    STOPTASKS,${TMPDIR},1G,100K \
    STOPTASKS,${DL_DIR},1G,100K \
    STOPTASKS,${SSTATE_DIR},1G,100K \
    STOPTASKS,/tmp,100M,100K \
    HALT,${TMPDIR},100M,1K \
    HALT,${DL_DIR},100M,1K \
    HALT,${SSTATE_DIR},100M,1K \
    HALT,/tmp,10M,1K"

CONF_VERSION = "2"
```

## sources/meta-obe/conf/layer.conf
```bitbake
# We have a conf and classes directory, add to BBPATH
BBPATH .= ":${LAYERDIR}"

# We have recipes-* directories, add to BBFILES
BBFILES += "${LAYERDIR}/recipes-*/*/*.bb \
            ${LAYERDIR}/recipes-*/*/*.bbappend"

BBFILE_COLLECTIONS += "meta-obe"
BBFILE_PATTERN_meta-obe = "^${LAYERDIR}/"
BBFILE_PRIORITY_meta-obe = "6"

LAYERDEPENDS_meta-obe = "core"
LAYERSERIES_COMPAT_meta-obe = "nanbield"
```

## sources/meta-obe/conf/machine/imx8mn-ddr4-evk-ar1335.conf
```bitbake
#@TYPE: Machine
#@NAME: i.MX 8MN and Camera Machine
#@DESCRIPTION: A machine for i.MX 8MN DDR4 EVK and camera
#@MAINTAINER: Chris Storah <chris.storah@gmail.com>

require conf/machine/include/imx8mn-evk.inc

# KERNEL_DEVICETREE_BASENAME = "${MACHINE}"
KERNEL_DEVICETREE_BASENAME = "imx8mn-ddr4-evk"
UBOOT_CONFIG_BASENAME = "imx8mn_ddr4_evk"

DDR_FIRMWARE_VERSION = "201810"
DDR_FIRMWARE_NAME = " \
    ddr4_imem_1d_${DDR_FIRMWARE_VERSION}.bin \
    ddr4_dmem_1d_${DDR_FIRMWARE_VERSION}.bin \
    ddr4_imem_2d_${DDR_FIRMWARE_VERSION}.bin \
    ddr4_dmem_2d_${DDR_FIRMWARE_VERSION}.bin \
"
IMXBOOT_TARGETS_BASENAME = "flash_ddr4_evk"

# Mainline BSP doesn't support DDR4 so it must be set to nxp.
# Also this machine isn't supported by u-boot-fslc but imx8mn-evk.inc already
# set the bootloader to u-boot-imx instead when NXP BSP is used.
IMX_DEFAULT_BSP = "nxp"
```

## sources/meta-obe/conf/machine/poc.conf
```bitbake
#@TYPE: Machine
#@NAME: NXP i.MX 8M Nano Evaluation Kit with DDR4
#@SOC: i.MX8MM
#@DESCRIPTION: Machine configuration for NXP i.MX 8M Nano EVK with DDR4
#@MAINTAINER: Andrey Zhizhikin <andrey.z@gmail.com>

require conf/machine/include/imx8mn-evk.inc

# KERNEL_DEVICETREE_BASENAME = "${MACHINE}"
KERNEL_DEVICETREE_BASENAME = "imx8mn-ddr4-evk-poc"
KERNEL_DEVICETREE = "freescale/${KERNEL_DEVICETREE_BASENAME}.dtb "
KERNEL_DEVICETREE:append = "freescale/${KERNEL_DEVICETREE_BASENAME}-ar0144.dtb "

UBOOT_CONFIG_BASENAME = "imx8mn_ddr4_evk"
UBOOT_CONFIG[nom] = "${UBOOT_CONFIG_BASENAME}_nom_defconfig"

DDR_FIRMWARE_VERSION = "201810"
DDR_FIRMWARE_NAME = " \
    ddr4_imem_1d_${DDR_FIRMWARE_VERSION}.bin \
    ddr4_dmem_1d_${DDR_FIRMWARE_VERSION}.bin \
    ddr4_imem_2d_${DDR_FIRMWARE_VERSION}.bin \
    ddr4_dmem_2d_${DDR_FIRMWARE_VERSION}.bin \
"
IMXBOOT_TARGETS_BASENAME = "flash_ddr4_evk"
IMX_DEFAULT_BSP = "mainline"
```

## sources/meta-obe/meta-multimedia/conf/layer.conf
```bitbake
# conf and classes directory, add to BBPATH
BBPATH .= ":${LAYERDIR}"

# packages directory, add to BBFILES
BBFILES += "${LAYERDIR}/recipes-*/*/*.bb \
            ${LAYERDIR}/recipes-*/*/*.bbappend"
```

## sources/meta-obe/meta-sdk/conf/distro/obe-imx-wayland.conf
```bitbake
# i.MX DISTRO for Wayland without X11

require conf/distro/poky.conf

DISTRO = "obe-imx-wayland"

# PREFERRED_PROVIDER_virtual/kernel = "linux-obe"

PREFERRED_PROVIDER_virtual/kernel = "linux-fslc"
PREFERRED_VERSION_linux-fslc = "6.6%"

POKY_DEFAULT_DISTRO_FEARURES:append = " jailhouse"
DEFAULTTUNE ?= "armv8a-crc-crypto"
PACKAGECONFIG:append:pn-systemd = " unmanaged-network"

#PREFERRED_PROVIDER_virtual/bootloader:imx-nxp-bsp = "u-boot-imx"
#PREFERRED_PROVIDER_virtual/kernel = "linux-obe"
#PREFERRED_PROVIDER_linux-imx-mfgtool = "linux-imx-mfgtool"

#PREFERRED_VERSION_gstreamer1.0              = "1.22.0.imx"
#PREFERRED_VERSION_gstreamer1.0-plugins-base = "1.22.0.imx"
#PREFERRED_VERSION_gstreamer1.0-plugins-good = "1.22.0.imx"
#PREFERRED_VERSION_gstreamer1.0-plugins-bad  = "1.22.0.imx"
#PREFERRED_VERSION_gstreamer1.0-plugins-ugly = "1.22.%"
#PREFERRED_VERSION_gstreamer1.0-libav        = "1.22.%"
#PREFERRED_VERSION_gstreamer1.0-rtsp-server  = "1.22.%"
#
#PREFERRED_VERSION_gstreamer1.0:mx8-nxp-bsp              = "1.22.0.imx"
#PREFERRED_VERSION_gstreamer1.0-plugins-base:mx8-nxp-bsp = "1.22.0.imx"
#PREFERRED_VERSION_gstreamer1.0-plugins-good:mx8-nxp-bsp = "1.22.0.imx"
#PREFERRED_VERSION_gstreamer1.0-plugins-bad:mx8-nxp-bsp  = "1.22.0.imx"
#PREFERRED_VERSION_gstreamer1.0-plugins-ugly:mx8-nxp-bsp = "1.22.%"
#PREFERRED_VERSION_gstreamer1.0-libav:mx8-nxp-bsp        = "1.22.%"
#PREFERRED_VERSION_gstreamer1.0-rtsp-server:mx8-nxp-bsp  = "1.22.%"

##BBMASK += "meta-freescale/recipes-multimedia/gstreamer"

PREFERRED_VERSION_opengl-es-cts:aarch64 = "3.2.8.0"

# Use systemd as default init manager
VIRTUAL-RUNTIME_init_manager = "systemd"
PREFERRED_PROVIDER_udev = "systemd"
PREFERRED_PROVIDER_udev-utils = "systemd"
DISTRO_FEATURES_BACKFILL_CONSIDERED = "sysvinit"
POKY_DEFAULT_DISTRO_FEATURES += " systemd"


# Remove conflicting backends
DISTRO_FEATURES:remove = "directfb x11 "
DISTRO_FEATURES:append = " wayland pam systemd "
```
